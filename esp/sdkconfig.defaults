## esp/sdkconfig.defaults
```kconfig
# ESP32-S3 Bridge Config
CONFIG_IDF_TARGET="esp32s3"
CONFIG_ESPTOOLPY_FLASHMODE_DIO=y
CONFIG_ESPTOOLPY_FLASHSIZE_8MB=y
CONFIG_ESPTOOLPY_FLASHFREQ_40M=y
CONFIG_ESPTOOLPY_BAUD_115200B=y
CONFIG_ESPTOOLPY_PORT="COM4"
CONFIG_LWIP_SO_REUSEADDR=y

# Fix GCC ICE (segfault) in esp_lcd_panel_rgb.c RTL pass
CONFIG_COMPILER_OPTIMIZATION_ASSERTIONS_DISABLE=y
CONFIG_COMPILER_OPTIMIZATION_DEFAULT=y
```
